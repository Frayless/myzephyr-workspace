## trans-application/drivers/pi15592/Kconfig
```kconfig
config PI15592
	bool "PI15592 driver"
	default y
	depends on DT_HAS_PISEMI_PI15592_ENABLED
	select SPI
	help
	  Enable the driver PI15592.

if PI15592

config PI15592_INIT_PRIORITY
	int "pi15592 init priority"
	default 90
	help
	  pi15592 initialization priority.

config PI15592_LOG_LEVEL
	int "Default log level for pi15592"
	default 4
	help
		The default log level, which is used to filter log messages.

		0: None
		1: Error
		2: Warn
		3: Info
		4: Debug
		5: Verbose

config PI15592_ACQUISITION_THREAD_STACK_SIZE
	int "Stack size for the ADC data acquisition thread"
	default 384
	help
	  Size of the stack used for the internal data acquisition thread.

config PI15592_ACQUISITION_THREAD_PRIO
	int "Priority for the ADC data acquisition thread"
	default 0
	help
	  Priority level for the internal ADC data acquisition thread.

endif #PI15592
```

## trans-application/drivers/tec/Kconfig
```kconfig
config LIB_SGM41296
	bool "Enable the driver library for the Thermoelectric Cooler Driver"
	default y
	depends on DT_HAS_SGMICRO_SGM41296_ENABLED
	select I2C
	help
	  Helper functions for controlling the Thermoelectric Cooler Driver.
	  Features include XXX

if LIB_SGM41296

config SGM41296_INIT_PRIORITY
	int "sgm41296 init priority"
	default 90
	help
	  sgm41296 initialization priority.

config SGM41296_LOG_LEVEL
	int "Default log level for libsgm41296"
	default 4
	help
		The default log level, which is used to filter log messages.

		0: None
		1: Error
		2: Warn
		3: Info
		4: Debug
		5: Verbose

endif #LIB_SGM41296
```

## trans-application/dts/bindings/pi15592/pisemi,pi15592.yaml
```yaml
# Copyright (c) 2024 Golioth, Inc.
# SPDX-License-Identifier: Apache-2.0

description: "pi15592 ADC/DAC and GPIO controller"

compatible: "pisemi,pi15592"

#gpio-controller.yaml
include: [spi-device.yaml, adc-controller.yaml, dac-controller.yaml]

properties:
  "#io-channel-cells":
    const: 1

io-channel-cells:
  - input
```

## trans-application/dts/bindings/tec/sgmicro,sgm41296.yaml
```yaml
# Copyright (c) 2024 Golioth, Inc.
# SPDX-License-Identifier: Apache-2.0

description: "Thermoelectric Cooler Driver"

compatible: "sgmicro,sgm41296"

#i2c-device ? i2c-controller
include: [i2c-device.yaml]
```
